
#include <Keypad.h>
#include <MD_Parola.h>
#include <MD_MAX72xx.h>
#include <SPI.h>

#define DIN 2
#define CS 4
#define CLK 5

#define HW_TYPE MD_MAX72XX::FC16_HW

MD_MAX72XX mx = MD_MAX72XX(HW_TYPE, DIN, CLK, CS, 1);

char keys[4][4] = {
  { '1', '2', '3', 'A' },
  { '4', '5', '6', 'B' },
  { '7', '8', '9', 'C' },
  { '*', '0', '#', 'D' }
};

uint8_t numm[16][8] = {
  { 0x00, 0x3C, 0x42, 0x46, 0x4A, 0x52, 0x62, 0x3C },  // 0
  { 0x00, 0x18, 0x38, 0x38, 0x18, 0x18, 0x18, 0x3C },  // 1
  { 0x00, 0x38, 0x44, 0x04, 0x08, 0x10, 0x20, 0x7C },  // 2
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  { 0x00, 0x7C, 0x40, 0x40, 0x78, 0x40, 0x40, 0x40 }   // F
};

byte rowPin[4] = { 13, 12, 14, 27 };
byte colPin[4] = { 26, 25, 33, 32 };

Keypad keypad = Keypad(makeKeymap(keys), rowPin, colPin, 4, 4);

void setup() {
  Serial.begin(115200);
  mx.begin();
  mx.control(MD_MAX72XX::INTENSITY, 2);
  mx.clear();
}

void displayMetrix(int index) {
  mx.clear();
  for (int i = 0; i < 8; i++) {
    mx.setColumn(0, 7 - i, numm[index][i]);
  }
}

void loop() {
  char key = keypad.getKey();

  if (key) {
    Serial.println(key);
    if (key >= '0' && key <= '9') {
      displayMetrix(key - '0');
    } else if (key == 'A') displayMetrix(10);
    else if (key == 'B') displayMetrix(11);
    else if (key == 'C') displayMetrix(12);
    else if (key == 'D') displayMetrix(13);
    else if (key == '*') displayMetrix(14);
    else if (key == '#') displayMetrix(15);
  }
}
